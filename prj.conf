## CMakeLists.txt
```
# SPDX-License-Identifier: Apache-2.0

cmake_minimum_required(VERSION 3.20.0)

find_package(Zephyr REQUIRED HINTS $ENV{ZEPHYR_BASE})
project(puppy_samples)

# Verify that this sample is built through sysbuild to ensure MCUboot is
# automatically included and that sample specific MCUboot configurations are
# used when building MCUboot.
test_sysbuild()

target_sources(app PRIVATE src/main.c)
```

## west.yml
```
manifest:
    remotes:
        - name: caninos
          url-base: https://github.com/caninos-loucos

    projects:
        - name: puppy-zephyr
          remote: caninos
          revision: main
          path: zephyr
          import:
              name-allowlist:
                  - mcuboot
                  - zcbor
```

## prj.conf
```kconfig
CONFIG_CBPRINTF_FP_SUPPORT=y
CONFIG_PWM=y
CONFIG_GPIO=y
```

## src/main.c
```c
#include <zephyr/device.h>
#include <zephyr/kernel.h>
#include <zephyr/sys/printk.h>

int main(void)
{
    while (1)
    {
        printk("Hello World from Puppy!\n");
        k_usleep(1000000);
    }
    return 0;
}
```
